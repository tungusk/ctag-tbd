## main/Kconfig.projbuild
```kconfig
menu "CTAG TBD Configuration"

    config TBD_LEGACY_PLUGIN_SUPPORT
        bool "Enable Legacy Plugin Support"
        default n
        help
            Enable support for legacy plugins in TBD. This allows older plugins to run on the system.
            Disabling this may improve performance and reduce memory usage if legacy plugin support is not needed.

    menu "TBD Hardware Configuration"
        config TBD_USE_SD_CARD
            bool "Enable SD Card Support"
            default y
            help
                Enable SD card as the storage backend for presets, WebUI, and samples.
                When disabled, the system uses LittleFS flash partitions for presets/WebUI
                and a flash partition for the sample ROM (.tbd binary format).
                Disable this for boards without an SD card socket (Config A, Config B).

        config TBD_USE_RP2350
            bool "Enable RP2350 Sequencer Bridge"
            default y
            help
                Enable the RP2350 SPI bridge for hardware sequencer, OLED display,
                and MIDI routing via the Pico subsystem.
                When disabled, MIDI is received directly via ESP32-P4 native USB-MIDI
                (TinyUSB), and SPI2/SPI3 buses are not initialized (freeing 10 GPIO pins).
                Disable this for boards without an RP2350 (Config A, Config C).
    endmenu

    config ABLETON_LINK
        bool "Enable Ableton Link Support"
        default y
        help
            Enable Ableton Link support for tempo synchronization over network.

    config ABLETON_LINK_DEBUG
        bool "Enable Ableton Link Debug Output"
        default n
        depends on ABLETON_LINK
        help
            Enable debug output for Ableton Link.

    menu "Sample ROM Settings"
        config MAX_ALLOC_BYTES_PSRAM_SAMPLE_DATA
            int "Maximum PSRAM Allocation Size Sample Data"
            default 29360128 # 28MB
            range 8388608 31457280 # 8MB to 30MB
            help
                Define maximum PSRAM allocation size for sample data in ctagSampleRom.
                Files from sd-card will be stored here.
                All mem allocated here is not available for other uses, when ctagSampleRom is instantiated.

        config MAX_SAMPLES_IN_SAMPLE_ROM
            int "Maximum Number of Samples in Sample ROM"
            default 128
            range 32 1024 # max 32*32 addressable in web ui
            help
                Define maximum number of samples in sample rom.
                This limits the number of sample slots available in ctagSampleRom.
                It is samples, i.e. files from sd-card, that are loaded into sample rom, not bytes.
    endmenu

    config SP_FIXED_MEM_ALLOC_SZ
        int "Sound Processor Fixed Memory Alloc Size"
        default 300000
        range 113944 380000
        help
            Define sound processor fixed memory size allocated at startup.
            Sound processors are allocated from this memory pool.

    menu "Optional Tasks"
        config TASK_REST_SERVER
            bool "Start REST Server Task"
            default y
            help
                Enable REST server task for handling HTTP requests offering TBD web-ui.

        config TASK_RGB_INDICATOR_LED
            bool "Enable RGB Indicator LED Task"
            default n
            help
                Drives indicator RGB LED to show system status.

    endmenu

    menu "Optimizations"
        config ASSEMBLY_OPT_AUDIO_BUFFER_CODEC
            bool "Enable Assembly Optimizations for Audio Buffer Codec"
            default y
            help
                Enable assembly optimizations for audio buffer codec processing to improve performance.
                P4 F-extension, loop unrolling, hardware loop and other optimizations are used.
                Works only for 32 samples per buffer configuration. Small improvement.

        choice TBD_SDMMC_TIMING_MODE
            prompt "SD Card SDMMC timing mode"
            default TBD_SDMMC_TIMING_HS_4BIT_PHASE2
            depends on TBD_USE_SD_CARD
            help
                Select SDMMC bus timing for the P4 SD card slot. ESP32-P4 rev
                3.1 on this board needs explicit sampling delay for stable
                4-bit transfers.

            config TBD_SDMMC_TIMING_HS_1BIT
                bool "High-speed 40 MHz, 1-bit"
                help
                    Conservative fallback. Stable in testing, but lower
                    throughput because only DAT0 is used.

            config TBD_SDMMC_TIMING_HS_4BIT_PHASE2
                bool "High-speed 40 MHz, 4-bit, phase 2"
                help
                    Stable 4-bit high-speed mode with manual input delay phase
                    2. Observed sample load throughput around 5 MB/s.

            config TBD_SDMMC_TIMING_SDR50_4BIT_PHASE2
                bool "UHS-I SDR50 100 MHz, 4-bit, phase 2"
                help
                    Fastest working mode tested so far. DDR is explicitly
                    disabled because IDF otherwise prefers DDR50 for UHS-I
                    cards, which was unstable on this board.
        endchoice
    endmenu

    menu "Compiler"
        config TBD_SUPPRESS_COMPILER_WARNINGS
            bool "Suppress Compiler Warnings"
            default n
            help
                Suppress specific compiler warnings to reduce build output noise.
                Use with caution, as it may hide important warnings about potential issues in the code.
    endmenu

endmenu
```

## tests/sdmmc_stress/main/Kconfig.projbuild
```kconfig
menu "TBD SDMMC Stress Test"

    config TEST_ENABLE_ESP_HOSTED
        bool "Enable ESP-Hosted SDIO co-processor during SD card test"
        default n
        select ESP_HOSTED_ENABLED
        help
            Enables ESP-Hosted over SDIO slot 1. As in the real firmware, the
            component performs low-level Hosted/SDIO initialization before
            app_main(), then the test mounts the SD card on slot 0 with SDMMC
            host init suppressed.

    config TEST_ESP_HOSTED_REQUIRED
        bool "Fail test if ESP-Hosted cannot connect"
        default y
        depends on TEST_ENABLE_ESP_HOSTED

    config TEST_ESP_HOSTED_START_BEFORE_SD
        bool "Start ESP-Hosted before mounting SD card"
        default n
        depends on TEST_ENABLE_ESP_HOSTED
        help
            Legacy synthetic test mode. Keep disabled for production-order
            testing; the real firmware does not explicitly start ESP-Hosted
            from app_main() before FileSystem::InitFS().

    choice TEST_SDMMC_TIMING_MODE
        prompt "SD Card SDMMC timing mode"
        default TEST_SDMMC_TIMING_SDR50_4BIT_PHASE2
        help
            Select the SDMMC bus timing to test.

        config TEST_SDMMC_TIMING_HS_1BIT
            bool "High-speed 40 MHz, 1-bit"

        config TEST_SDMMC_TIMING_HS_4BIT
            bool "High-speed 40 MHz, 4-bit"

        config TEST_SDMMC_TIMING_SDR50_4BIT_PHASE2
            bool "UHS-I SDR50 100 MHz, 4-bit, phase 2"
    endchoice

    config TEST_SDMMC_HS_DELAY_PHASE
        int "High-speed input delay phase"
        default 2
        range 0 7
        depends on TEST_SDMMC_TIMING_HS_1BIT || TEST_SDMMC_TIMING_HS_4BIT
        help
            SDMMC input delay phase to use in high-speed modes. ESP32-P4
            supports phase 0..7; testing higher phases can help identify
            marginal timing after soft reset.

    config TEST_SDMMC_POWER_CYCLE
        bool "Power-cycle SD card before each mount"
        default y

    config TEST_SDMMC_FORCE_3V3_BEFORE_POWER_CYCLE
        bool "Force SD IO voltage to 3.3V before power-cycle"
        default y
        depends on TEST_SDMMC_POWER_CYCLE

    config TEST_SDMMC_CARD_POWER_GPIO
        int "SD card power-enable GPIO"
        default 45

    config TEST_SDMMC_SETTLE_MS
        int "SD card power-on settle time in ms"
        default 500

    config TEST_SDMMC_RETRY_NON_UHS_MOUNTS
        int "Retry count when SDR50/UHS-I mount falls back below UHS speed"
        default 2
        depends on TEST_SDMMC_TIMING_SDR50_4BIT_PHASE2
        help
            If the card mounts but does not enter UHS speed after reset, unmount
            and retry the full mount sequence this many times before continuing.
            This prevents destructive ZIP writes when the reset left the card in
            a non-UHS state.

    config TEST_SDMMC_CYCLES
        int "Write/read/remount test cycles"
        default 100

    config TEST_SDMMC_REBOOT_AFTER_CYCLES
        int "Soft reboot after successful IO cycles"
        default 0
        help
            If greater than zero, the test calls esp_restart() after this many
            successful write/read/remount cycles. This exercises the soft-reset
            failure mode seen with SDMMC/ESP-Hosted without relying on monitor
            key sequences.

    config TEST_SDMMC_FILE_SIZE_KB
        int "Test file size in KiB"
        default 8192

    config TEST_SDMMC_IO_CHUNK_KB
        int "POSIX read/write chunk size in KiB"
        default 64

    config TEST_SDMMC_FSYNC_EACH_CHUNK
        bool "fsync after each write chunk"
        default n

    config TEST_SDMMC_UNMOUNT_EACH_CYCLE
        bool "Unmount/remount between cycles"
        default y

    config TEST_SDMMC_EXTRACT_ZIP_AT_BOOT
        bool "Extract /sdcard/dada-tbd-sd.zip at boot"
        default y
        help
            Recreates the main firmware's SD image update workload on every
            boot. The test deletes data, www, and samples before extracting
            the ZIP, then writes .version if dada-tbd-sd-hash.txt exists.

    config TEST_SDMMC_READ_ZIP_BENCHMARK
        bool "Benchmark sequential read of /sdcard/dada-tbd-sd.zip before extraction"
        default y
        help
            Reads the production SD image ZIP once before extraction and logs
            sequential read throughput without creating extra files.

    config TEST_SDMMC_USE_BOUNCE_WRAPPER
        bool "Wrap SDMMC sector IO through PSRAM DMA bounce buffer"
        default y

    config TEST_SDMMC_BOUNCE_BUFFER_IN_PSRAM
        bool "Allocate bounce buffer in PSRAM"
        default y
        depends on TEST_SDMMC_USE_BOUNCE_WRAPPER

endmenu
```

## tests/sdmmc_stress/sdkconfig.defaults
```kconfig
CONFIG_IDF_TARGET="esp32p4"
CONFIG_ESPTOOLPY_FLASHSIZE_16MB=y
CONFIG_ESPTOOLPY_FLASHMODE_QIO=y
CONFIG_ESPTOOLPY_FLASHFREQ_80M=y
CONFIG_SPIRAM=y
CONFIG_SPIRAM_MODE_HEX=y
CONFIG_SPIRAM_SPEED_200M=y
CONFIG_SPIRAM_USE_MALLOC=y
CONFIG_FATFS_USE_FASTSEEK=y
CONFIG_FATFS_IMMEDIATE_FSYNC=y
CONFIG_FATFS_USE_DYN_BUFFERS=n
CONFIG_ESP_WIFI_REMOTE_ENABLED=n
CONFIG_ESP_HOSTED_ENABLED=n
CONFIG_TEST_SDMMC_TIMING_HS_4BIT=y
CONFIG_TEST_SDMMC_HS_DELAY_PHASE=4
CONFIG_TEST_SDMMC_POWER_CYCLE=y
CONFIG_TEST_SDMMC_FORCE_3V3_BEFORE_POWER_CYCLE=y
CONFIG_TEST_SDMMC_SETTLE_MS=500
CONFIG_TEST_SDMMC_EXTRACT_ZIP_AT_BOOT=y
CONFIG_TEST_SDMMC_READ_ZIP_BENCHMARK=y
CONFIG_TEST_SDMMC_USE_BOUNCE_WRAPPER=y
CONFIG_TEST_SDMMC_BOUNCE_BUFFER_IN_PSRAM=y
```

## tests/sdmmc_stress/sdkconfig.defaults.hosted
```kconfig
CONFIG_TEST_ENABLE_ESP_HOSTED=y
CONFIG_TEST_ESP_HOSTED_REQUIRED=y
CONFIG_TEST_ESP_HOSTED_START_BEFORE_SD=n
CONFIG_SLAVE_IDF_TARGET_ESP32C6=y
CONFIG_ESP_WIFI_REMOTE_ENABLED=y
CONFIG_ESP_WIFI_REMOTE_LIBRARY_HOSTED=y
CONFIG_ESP_HOSTED_ENABLED=y
CONFIG_ESP_HOSTED_CP_TARGET_ESP32C6=y
CONFIG_ESP_HOSTED_P4_DEV_BOARD_NONE=y
CONFIG_ESP_HOSTED_SDIO_HOST_INTERFACE=y
CONFIG_ESP_HOSTED_SDIO_SLOT_1=y
CONFIG_ESP_HOSTED_SDIO_4_BIT_BUS=y
CONFIG_ESP_HOSTED_SDIO_CLOCK_FREQ_KHZ=40000
CONFIG_ESP_HOSTED_SDIO_GPIO_RESET_SLAVE=54
CONFIG_ESP_HOSTED_SLAVE_RESET_ON_EVERY_HOST_BOOTUP=y
CONFIG_ESP_HOSTED_DFLT_TASK_FROM_SPIRAM=y
CONFIG_ESP_HOSTED_USE_MEMPOOL=n
```
